## hcsr04-driver/Config.in
```kconfig
source "$BR2_EXTERNAL_HCSR04_DRIVER_PATH/package/hcsr04-driver/Config.in"
source "$BR2_EXTERNAL_HCSR04_DRIVER_PATH/package/hcsr04-server/Config.in"
```

## hcsr04-driver/package/hcsr04-driver/Config.in
```kconfig
config BR2_PACKAGE_HCSR04_DRIVER
    bool "hcsr04-driver"
    depends on BR2_LINUX_KERNEL
    help
      Driver kernel module for the HC-SR04 ultrasonic range sensor.
```

## hcsr04-driver/package/hcsr04-server/Config.in
```kconfig
config BR2_PACKAGE_HCSR04_SERVER
    bool "hcsr04-server"
    depends on BR2_PACKAGE_HCSR04_DRIVER
    depends on BR2_INIT_SYSTEMD
    help
      User-space TCP/IP server for the hcsr04 ultrasonic sensor.
      
      This application reads distance data from the kernel driver
      (/dev/hcsr04) and serves it over the network.
```
